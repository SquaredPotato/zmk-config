\ {
   left_encoder: encoder_left {
      compatible = "alps,ec11";
      label = "LEFT_ENCODER";
      a-gpios = <&pro_micro_d 9 ((0 << 0) | (1 << 4))>;
      b-gpios = <&pro_micro_d 5 ((0 << 0) | (1 << 4))>;
      resolution = <2>;
      status = "disabled";
   };
   right_encoder: encoder_right {
      compatible = "alps,ec11";
      label = "RIGHT_ENCODER";
      a-gpios = <&pro_micro_d 5 ((0 << 0) | (1 << 4))>;
      b-gpios = <&pro_micro_d 9 ((0 << 0) | (1 << 4))>;
      resolution = <2>;
      status = "disabled";
   };
}